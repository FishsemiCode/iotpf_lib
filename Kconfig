## Kconfig
```kconfig
#
# For a description of the syntax of this configuration file,
# see the file kconfig-language.txt in the NuttX tools repository.
#
config SERVICES_IOTPF_LIB
	bool "Services IOTPF lib"
	default n
	---help---
		Enable the IOTPF library

config SERVICES_IOTPF_LIB_MODE
	string "cmcc or ctcc"
	default "ctcc"
	---help---
		The platform nb device connected to
```
